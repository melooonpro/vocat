## main/Kconfig.projbuild
```kconfig
menu "VoCat Desktop"

    config VOCAT_WIFI_SSID
        string "Wi-Fi SSID"
        default ""
        help
            Wireless network name used by the desktop clock.

    config VOCAT_WIFI_PASSWORD
        string "Wi-Fi password"
        default ""
        help
            Leave empty only for an open wireless network.

    config VOCAT_TIMEZONE
        string "POSIX timezone"
        default "CST-8"
        help
            POSIX TZ string. China Standard Time is CST-8.

    config VOCAT_NTP_SERVER
        string "NTP server"
        default "ntp.aliyun.com"

    config VOCAT_CLOCK_24_HOUR
        bool "Use 24-hour time"
        default y

    config VOCAT_DEBUG_UART_ENABLE
        bool "Enable secondary debug UART"
        default y
        help
            Copy application log output to a separate hardware UART. This
            does not change the USB Serial/JTAG console used for flashing.

    config VOCAT_DEBUG_UART_PORT
        int "Secondary debug UART port"
        range 0 2
        default 1
        depends on VOCAT_DEBUG_UART_ENABLE

    config VOCAT_DEBUG_UART_TX_GPIO
        int "Secondary debug UART TX GPIO"
        range -1 48
        default 5
        depends on VOCAT_DEBUG_UART_ENABLE

    config VOCAT_DEBUG_UART_RX_GPIO
        int "Secondary debug UART RX GPIO"
        range -1 48
        default 6
        depends on VOCAT_DEBUG_UART_ENABLE

    config VOCAT_DEBUG_UART_BAUDRATE
        int "Secondary debug UART baud rate"
        range 1200 2000000
        default 115200
        depends on VOCAT_DEBUG_UART_ENABLE

endmenu
```

## sdkconfig.defaults.n32r16
```kconfig
# VoCat v1.0 / ESP32-S3-WROOM-2-N32R16V
CONFIG_IDF_TARGET="esp32s3"
CONFIG_ESP_DEFAULT_CPU_FREQ_MHZ_240=y

# 32 MB 1.8 V octal flash (OPI/DTR)
CONFIG_ESPTOOLPY_OCT_FLASH=y
# CONFIG_ESPTOOLPY_FLASH_MODE_AUTO_DETECT is not set
CONFIG_ESPTOOLPY_FLASHMODE_OPI=y
CONFIG_ESPTOOLPY_FLASH_SAMPLE_MODE_DTR=y
CONFIG_ESPTOOLPY_FLASHFREQ_80M=y
CONFIG_ESPTOOLPY_FLASHSIZE_32MB=y

# 16 MB 1.8 V octal PSRAM
CONFIG_SPIRAM=y
CONFIG_SPIRAM_MODE_OCT=y
CONFIG_SPIRAM_SPEED_80M=y

CONFIG_ESP_CONSOLE_USB_SERIAL_JTAG=y
CONFIG_ESP_CONSOLE_SECONDARY_NONE=y
CONFIG_BOOTLOADER_LOG_LEVEL_WARN=y
CONFIG_USJ_ENABLE_USB_SERIAL_JTAG=y

CONFIG_LV_FONT_MONTSERRAT_20=y
CONFIG_LV_FONT_MONTSERRAT_28=y
# CONFIG_LV_BUILD_EXAMPLES is not set
# CONFIG_LV_BUILD_DEMOS is not set

CONFIG_USB_DEVICE_UAC_AS_PART=y
CONFIG_UAC_SPEAKER_CHANNEL_NUM=0
CONFIG_UAC_MIC_CHANNEL_NUM=1
CONFIG_UAC_SAMPLE_RATE=48000
CONFIG_UAC_BIT_RESOLUTION_16=y
CONFIG_UAC_MIC_INTERVAL_MS=10
# CONFIG_UAC_SUPPORT_MACOS is not set

CONFIG_COMPILER_OPTIMIZATION_SIZE=y

# Two 360x36 RGB565 DMA buffers use 51,840 bytes of internal RAM.
CONFIG_BSP_LCD_DRAW_BUF_HEIGHT=36
CONFIG_BSP_LCD_DRAW_BUF_DOUBLE=y

CONFIG_PARTITION_TABLE_CUSTOM=y
CONFIG_PARTITION_TABLE_CUSTOM_FILENAME="partitions_n32r16.csv"
```
